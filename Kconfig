## Kconfig
```kconfig
#
# This file is part of Edgehog.
#
# Copyright 2021 SECO Mind Srl
#
# Licensed under the Apache License, Version 2.0 (the "License");
# you may not use this file except in compliance with the License.
# You may obtain a copy of the License at
#
#    http://www.apache.org/licenses/LICENSE-2.0
#
# Unless required by applicable law or agreed to in writing, software
# distributed under the License is distributed on an "AS IS" BASIS,
# WITHOUT WARRANTIES OR CONDITIONS OF ANY KIND, either express or implied.
# See the License for the specific language governing permissions and
# limitations under the License.
#
# SPDX-License-Identifier: Apache-2.0
#

menu "Edgehog SDK"

config INDICATOR_GPIO_ENABLE
    bool "Activate Indicator LED GPIO"
    default false
    help
        Set to true if a LED that can be used as an indicator is present.

config INDICATOR_GPIO
    int "Indicator LED GPIO"
    depends on INDICATOR_GPIO_ENABLE
    help
        The GPIO number of the LED intended to be used as indicator.
endmenu
```

## examples/edgehog_app/main/Kconfig.projbuild
```kconfig
#
# This file is part of Edgehog.
#
# Copyright 2021 SECO Mind Srl
#
# Licensed under the Apache License, Version 2.0 (the "License");
# you may not use this file except in compliance with the License.
# You may obtain a copy of the License at
#
#    http://www.apache.org/licenses/LICENSE-2.0
#
# Unless required by applicable law or agreed to in writing, software
# distributed under the License is distributed on an "AS IS" BASIS,
# WITHOUT WARRANTIES OR CONDITIONS OF ANY KIND, either express or implied.
# See the License for the specific language governing permissions and
# limitations under the License.
#
# SPDX-License-Identifier: Apache-2.0
#

menu "Edgehog example"

menu "Astarte device configuration"

config CREDENTIALS_SECRET
    string "Credentials secret"
    default ""
    help
        Astarte device credential secret, generated when the device is added on an Astarte
        instance.

config DEVICE_ID
    string "Device hardware ID"
    default ""
    help
        Astarte device hardware id, generated when the device is added on an Astarte instance.

endmenu

menu "WiFi configuration"

    config WIFI_SSID
        string "WiFi SSID"
        default "myssid"
        help
            SSID (network name) for the demo to connect to.

    config WIFI_PASSWORD
        string "WiFi Password"
        default "mypassword"
        help
            WiFi password (WPA or WPA2) for the demo to use.

    choice WIFI_SAE_MODE
        prompt "WPA3 SAE mode selection"
        default ESP_WPA3_SAE_PWE_BOTH
        help
            Select mode for SAE as Hunt and Peck, H2E or both.
        config ESP_WPA3_SAE_PWE_HUNT_AND_PECK
            bool "HUNT AND PECK"
        config ESP_WPA3_SAE_PWE_HASH_TO_ELEMENT
            bool "H2E"
        config ESP_WPA3_SAE_PWE_BOTH
            bool "BOTH"
    endchoice

    config WIFI_PW_ID
        string "PASSWORD IDENTIFIER"
        depends on  ESP_WPA3_SAE_PWE_HASH_TO_ELEMENT|| ESP_WPA3_SAE_PWE_BOTH
        default ""
        help
            password identifier for SAE H2E

    config ESP_MAXIMUM_RETRY
        int "Maximum retry"
        default 5
        help
            Set the Maximum retry to avoid station reconnecting to the AP unlimited when the AP
            is really inexistent.

    choice WIFI_SCAN_AUTH_MODE_THRESHOLD
        prompt "WiFi Scan auth mode threshold"
        default WIFI_AUTH_WPA2_PSK
        help
            The weakest authmode to accept in the scan mode.
            This value defaults to WIFI_AUTH_WPA2_PSK incase password is present and
            WIFI_AUTH_OPEN is used.
            Please select WIFI_AUTH_WEP/WIFI_AUTH_WPA_PSK incase AP is operating in WEP/WPA
            mode.

        config WIFI_AUTH_OPEN
            bool "OPEN"
        config WIFI_AUTH_WEP
            bool "WEP"
        config WIFI_AUTH_WPA_PSK
            bool "WPA PSK"
        config WIFI_AUTH_WPA2_PSK
            bool "WPA2 PSK"
        config WIFI_AUTH_WPA_WPA2_PSK
            bool "WPA/WPA2 PSK"
        config WIFI_AUTH_WPA3_PSK
            bool "WPA3 PSK"
        config WIFI_AUTH_WPA2_WPA3_PSK
            bool "WPA2/WPA3 PSK"
        config WIFI_AUTH_WAPI_PSK
            bool "WAPI PSK"
    endchoice

endmenu

endmenu
```

## examples/edgehog_app/sdkconfig.defaults
```kconfig
# Do not include SoftAP in the build process. As we do not need to work as an Access Point.
CONFIG_ESP_WIFI_SOFTAP_SUPPORT=n

CONFIG_ESPTOOLPY_FLASHSIZE_4MB=y
CONFIG_PARTITION_TABLE_CUSTOM=y
CONFIG_PARTITION_TABLE_CUSTOM_FILENAME="edgehog_partition_example.csv"
```
